// SPDX-License-Identifier: GPL-2.0-only
// SPDX-FileCopyrightText: Copyright (C) 2024 The LineageOS Project

/dts-v1/;

#include "tegra210-p2571-0932.dts"

/ {
        compatible = "nvidia,p2571-0932", "nvidia,foster_e_hdd", "nvidia,tegra210";
};
