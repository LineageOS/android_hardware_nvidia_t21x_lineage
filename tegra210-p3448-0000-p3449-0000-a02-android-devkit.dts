// SPDX-License-Identifier: GPL-2.0-only
// SPDX-FileCopyrightText: Copyright (C) 2024 The LineageOS Project

/dts-v1/;

#include "tegra210-p3450-0000.dts"
#include "tegra210-porg-common.dtsi"
#include "tegra210-porg-pinmux-p3448-0000-a02.dtsi"

/ {
	nvidia,dtsfilename = __FILE__;

	firmware {
		android {
			compatible = "android,firmware";
			hardware = "porg_sd";
			boot_devices = "700b0000.mmc";
		};
	};
};
