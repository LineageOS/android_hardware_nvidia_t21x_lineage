// SPDX-License-Identifier: GPL-2.0-only
// SPDX-FileCopyrightText: Copyright (C) 2024 The LineageOS Project

/dts-v1/;

#include "tegra210-p2571-0932.dts"

/ {
	nvidia,dtsfilename = __FILE__;

	firmware {
		android {
			compatible = "android,firmware";
			hardware = "foster_e_hdd";
			boot_devices = "70020000.sata";
		};
	};

	pinmux@700008d4 {
		pinctrl-names = "default";
	};
};
