// SPDX-License-Identifier: GPL-2.0-only
// SPDX-FileCopyrightText: Copyright (C) 2024 The LineageOS Project

/dts-v1/;

#include "tegra210b01-p3425-0500-a04.dts"
#include "tegra210-lineage.dtsi"

/ {
	nvidia,dtsfilename = __FILE__;

	firmware {
		android {
			compatible = "android,firmware";
			hardware = "sif";
			boot_devices = "700b0600.mmc";
		};
	};

	pinmux@700008d4 {
		pinctrl-names = "default";
	};
};
